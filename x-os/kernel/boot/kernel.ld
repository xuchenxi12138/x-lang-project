/* ============================================================
 * kernel.ld —— 内核链接脚本
 * ============================================================
 *
 * ── 这个脚本要同时满足三个约束 ───────────────────────────
 *
 *   1. 入口必须在 0x10000（引导扇区跳到这里）
 *   2. 镜像要小（引导扇区一次能读的扇区数有限）
 *   3. 代码里的绝对地址必须准（布局错 = 一跑就飞）
 *
 * 三者里最难的是 2 与 3 的张力：X 生成的 `static V s[49152]`
 * 是 786 KB 的值栈，它**必须占地址**（链接器据此算出 .data 的
 * 位置），但不该**占文件**。
 *
 * ── 走过的三条错路，都验证过，不要重走 ───────────────────
 *
 *   ① `.bss_stack (NOLOAD)`  —— PE 后端直接忽略 NOLOAD，
 *      objdump 里该段根本不出现，786 KB 仍然算在 .data 里。
 *
 *   ② `objcopy --remove-section=.bss_stack` —— PE 格式不支持
 *      删除段，是空操作。而且 PE 段名上限 8 字节，10 字符的
 *      `.bss_stack` 被**静默截断**成 `.bss_sta`，于是连名字都
 *      对不上，看似写了却没生效。
 *
 *   ③ 逐段 `objcopy -j` 再 `cat` 拼接 —— 每个段各自从偏移 0
 *      开始，拼接后 .data 从「内存 0xe10c0」变成「文件 0x11400」，
 *      它内部所有绝对地址全错。
 *
 * ── 现在的解法：让值栈有专属段名 ─────────────────────────
 *
 * PE 后端没有 SHT_NOBITS，所以 786 KB 零一定会被写进文件 ——
 * 「不占文件」在 PE 上做不到。能做的是让它**独占一个段**，
 * 从而可以被 objcopy 精确排除。
 *
 * 生成器给裸机值栈加了 `__attribute__((section(".vstack")))`。
 * 显式段名与 -fdata-sections 是互斥的：GCC 用**完全等于**这个
 * 名字的段，不再追加 `$变量名` 后缀。于是这里可以精确匹配
 * `.vstack`，不必依赖「写在 .data 之前先抢段」的顺序技巧，
 * 地址顺序也就自然可以排在最后。
 *
 * ── 顺序（脆弱，改动前先读）─────────────────────────────
 *
 *   .text     0x10000 起，入口必须在这里
 *   .rodata   紧跟 text
 *   .data     紧跟 rodata（到此为止的三段连续，全部导出）
 *   .vstack   排在最后，**不导出**
 *
 * 关键：.vstack 排在所有导出段之后，所以「不导出」不会在
 * 导出区里留下空洞。build.sh 有断言：kernel.bin 大小必须
 * 严格等于 .data 结束地址 - 0x10000。
 */

OUTPUT_FORMAT(pei-i386)
ENTRY(_entry)

SECTIONS
{
    /* 内核加载地址：与引导扇区的读盘目标一致（0x1000:0x0000）。
     * 物理地址即 0x10000 —— 段寄存器基址为 0 的平坦模型下，
     * 逻辑地址与物理地址相同。 */
    . = 0x10000;

    /* ── 入口段必须绝对排第一 ──────────────────────────────
     *
     * entry.s 只有几十字节（清值栈 + jmp），它是镜像的第一个
     * 字节。单独成段 + 显式放在最前，是「入口一定在 0x10000」
     * 的唯一可靠保证。理由见 entry.s 的文件头。
     *
     * `*(.text)` 与 `*(.text$*)` 都要写：
     *   · `*(.text)`     收没有 -ffunction-sections 后缀的（如 runtime.c
     *                    里没开该选项编译出的旧目标文件）
     *   · `*(.text$*)`   收 MinGW 给每个函数生成的 .text$函数名
     * 在 GNU ld 里 `$` 不是特殊字符，但不同版本对通配的处理
     * 有过差异，两个都写最稳。 */
    .text : AT(0)
    {
        *(.text.entry)
        *(.text)
        *(.text$*)
    }

    /* 只读数据：字符串常量、跳转表、字面量池。
     * .rdata 是 PE 的只读数据段名，.rodata 是 ELF 的 —— 两个
     * 都收，是为了同一份字节码在两种目标上都能链。 */
    .rodata :
    {
        *(.rodata)
        *(.rodata$*)
        *(.rdata)
        *(.rdata$*)
    }

    /* 已初始化的可写数据：字符串对象、全局状态。
     *
     * 注意 `*(.data$*)` 会连 .data$s.N（值栈的老段名）一起收进来 ——
     * 但那是**预期的**：值栈现在有了专属段 .vstack，GCC 不会再生成
     * .data$s.N。剩下的 .data$* 都是真正需要初始值的变量。
     *
     * 万一哪天有人把 X_VALUE_STACK 宏去掉了，值栈会重新落回
     * .data$s.N 被这里收走，镜像又变 857 KB —— 那时 build.sh 的
     * 大小断言会立刻报错，不会悄悄产出一个坏镜像。 */
    .data :
    {
        *(.data)
        *(.data$*)
    }

    /* ── 值栈：排在最后，不导出 ────────────────────────────
     *
     * 786 KB 的零，占据 0x10000 之后第 ~70 KB 处开始的地址空间。
     * 地址在这里被链接器算好，所以代码里对 s[i] 的引用是绝对
     * 地址，单靠 entry.s 的 rep stosl 清一遍即可使用。
     *
     * 段名 .vstack 是 7 字符，在 PE 的 8 字节上限内 —— 这是
     * 刻意的。超过 8 字符会被静默截断（见文件头错路②），
     * 那种错误极难发现，因为 objdump 里看到的是截断后的名字。
     *
     * 不导出 = 不在 objcopy 的 -j 列表里。因为它排在 .data 之后，
     * 这不产生任何文件内空洞。 */
    .vstack :
    {
        *(.vstack)
    }

    /* 值栈清零的边界。entry.s 用它算 rep stosl 的长度。
     *
     * 放在段外（不是 .vstack 内部），因为 entry.s 在 .text 段里
     * 引用这两个符号 —— 如果它们定义在 .vstack 段内，某些 ld
     * 版本会认为「跨段引用未初始化段内的符号」有问题。
     *
     * 用 ALIGN(4) 保证 rep stosl 的四字节对齐前提成立。 */
    . = ALIGN(4);
    __vstack_start = ADDR(.vstack);
    __vstack_end   = ADDR(.vstack) + SIZEOF(.vstack);

    /* 丢弃不需要的段。
     *
     * .reloc / .idata：内核不是动态加载的 PE，没有加载器来应用
     *   重定位、导入表也没有意义。
     * .debug* / .comment：调试信息不进镜像。
     * .eh_frame：GCC 可能生成异常展开表，-fno-asynchronous-unwind-tables
     *   没开时会有，裸机无异常，丢掉。 */
    /DISCARD/ :
    {
        *(.reloc)
        *(.edata)
        *(.idata)
        *(.eh_frame)
        *(.debug*)
        *(.comment)
    }
}